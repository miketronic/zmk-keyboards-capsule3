## zephyr/boards/shields/Kconfig.defconfig
```kconfig
# Copyright (c) 2024 The ZMK Contributors
# SPDX-License-Identifier: MIT

if SHIELD_capsule3

config ZMK_KEYBOARD_NAME
    default "Capsule3"

endif
```
